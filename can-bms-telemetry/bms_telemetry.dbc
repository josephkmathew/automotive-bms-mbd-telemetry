VERSION ""

NS_ :

BS_:

BU_: BMS VCU

BO_ 256 BMS_Status: 8 BMS
 SG_ PackVoltage_V : 0|16@1+ (0.01,0) [0|655.35] "V" VCU
 SG_ PackCurrent_A : 16|16@1- (0.1,-100) [-100|5553.5] "A" VCU

BO_ 512 BMS_SoC_Fault: 8 BMS
 SG_ SoC_Pct : 0|8@1+ (0.5,0) [0|100] "%" VCU
 SG_ Fault_Code : 8|8@1+ (1,0) [0|255] "" VCU
